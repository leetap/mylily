## config/west.yml
```yaml
manifest:
  remotes:
    - name: zmkfirmware
      url-base: https://github.com/zmkfirmware
    - name: arewhatyouit
      url-base: https://github.com/arewhatyouit
  projects:
    - name: zmk
      remote: zmkfirmware
      revision: v0.2
      import: app/west.yml
    - name: hammerbeam-slideshow
      remote: arewhatyouit
      revision: main
  self:
    path: config
```
